## meta-dream/conf/layer.conf
```bitbake
# We have a conf and classes directory, append to BBPATH
BBPATH .= ":${LAYERDIR}"

# We have a recipes directory, add to BBFILES
BBFILES += "${LAYERDIR}/recipes-*/*.bb ${LAYERDIR}/recipes-*/*.bbappend \
            ${LAYERDIR}/recipes-*/*/*.bb ${LAYERDIR}/recipes-*/*/*.bbappend \
            ${LAYERDIR}/recipes-*/*/*/*.bb ${LAYERDIR}/recipes-*/*/*/*.bbappend"

METADREAMBOX_BASE := '${@os.path.normpath("${LAYERDIR}/../")}'
# Prevent current directory creeping into sstate objects. Otherwise, building
# in another TOPDIR will cause recipes using this variable to be rebuilt.
METADREAMBOX_BASE[vardepvalue] = 'meta-dream'

# Additional license directories.
LICENSE_PATH += "${LAYERDIR}/conf/license"

FULL_OPTIMIZATION_dm500hd = "-Os -pipe ${DEBUG_FLAGS}"
O2_OPT_dm500hd = "-Os -pipe ${DEBUG_FLAGS}"
O3_OPT_dm500hd = "-Os -pipe ${DEBUG_FLAGS}"
FULL_OPTIMIZATION_dm800se = "-Os -pipe ${DEBUG_FLAGS}"
O2_OPT_dm800se = "-Os -pipe ${DEBUG_FLAGS}"
O3_OPT_dm800se = "-Os -pipe ${DEBUG_FLAGS}"
```

## meta-dream/conf/machine/dm520.conf
```bitbake
#@TYPE: Machine
#@NAME: Dreambox DM520
#@DESCRIPTION: Machine configuration for the Dreambox DM520

MACHINE_FEATURES += "modem kernelwifi externalwifi dvb-c blindscan-dvbc hdmicec recovery ci dvd usbconsole"

CHIPSET = "bcm73625"

require conf/machine/include/dreambox-mips32el.inc
require conf/machine/include/dreambox-mips32el-new.inc
```

## meta-dream/conf/machine/dm900.conf
```bitbake
#@TYPE: Machine
#@NAME: Dreambox DM900
#@DESCRIPTION: Machine configuration for the Dreambox DM900

MACHINE_FEATURES += " colorlcd390"

CHIPSET = "bcm7252s"
SOC_FAMILY = "bcm7252s"

require conf/machine/include/dreambox-arm.inc
```
